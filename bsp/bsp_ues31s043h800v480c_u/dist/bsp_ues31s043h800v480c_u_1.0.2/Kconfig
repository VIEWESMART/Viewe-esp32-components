## bsp/bsp_ues31s043h800v480c_u/dist/bsp_ues31s043h800v480c_u_1.0.2/Kconfig
```kconfig
menu "Board Support Package (UES31S043H800V480C-U)"

    config BSP_ERROR_CHECK
        bool "Enable error check in BSP"
        default y
        help
            Assert on BSP error instead of returning the error code.

    menu "I2C"
        config BSP_I2C_NUM
            int "I2C peripheral index"
            default 0
            range 0 1

        config BSP_I2C_CLK_SPEED_HZ
            int "I2C clock speed (Hz)"
            default 400000
    endmenu

    config BSP_I2S_NUM
        int "I2S peripheral index"
        default 0
        range 0 1

    menu "SD card"
        config BSP_SD_FORMAT_ON_MOUNT_FAIL
            bool "Format SD card if mounting fails"
            default n

        config BSP_SD_MOUNT_POINT
            string "SD card mount point"
            default "/sdcard"
    endmenu

    config BSP_NO_GRAPHIC_LIB
        bool "Build BSP without LVGL"
        default n
        help
            Keep hardware LCD/touch APIs only (bsp_display_new / bsp_touch_new).
            Leave this off to ship LVGL through esp_lvgl_port and call
            bsp_display_start() / bsp_display_lock() from the application.

    config BSP_LCD_DRAW_BUF_HEIGHT
        int "LVGL draw buffer height (lines)"
        default 40
        range 10 80
        depends on !BSP_NO_GRAPHIC_LIB
        help
            Used only if the RGB panel was opened with a single framebuffer.
            The locked path uses 2 framebuffers and direct mode instead.
            Half-screen partial buffers starve the RGB bounce ISR.

    config BSP_LCD_DRAW_BUF_DOUBLE
        bool "Allocate two LVGL draw buffers"
        default y
        depends on !BSP_NO_GRAPHIC_LIB

    menu "Display backlight PWM"
        config BSP_DISPLAY_BRIGHTNESS_LEDC_TIMER
            int "LEDC timer index for backlight"
            default 1
            range 0 3

        config BSP_DISPLAY_BRIGHTNESS_LEDC_CH
            int "LEDC channel index for backlight"
            default 1
            range 0 7
    endmenu

    menu "Buzzer PWM"
        config BSP_BUZZER_LEDC_TIMER
            int "LEDC timer index for buzzer"
            default 0
            range 0 3

        config BSP_BUZZER_LEDC_CH
            int "LEDC channel index for buzzer"
            default 0
            range 0 7
    endmenu

endmenu
```

## bsp/viewe_desknob/dist/viewe_desknob_0.1.2/Kconfig
```kconfig
menu "Viewe DeskNob"

    config BSP_ERROR_CHECK
        bool "Enable error check assert in BSP"
        default n
        help
            Abort on BSP errors instead of returning esp_err_t.

    config BSP_I2C_NUM
        int "Audio codec I2C port"
        default 0
        range 0 1
        help
            ES8311 bus. Touch uses the other I2C port.

    config BSP_I2C_CLK_SPEED_HZ
        int "Audio codec I2C clock (Hz)"
        default 400000
        range 100000 400000

    config BSP_LCD_BRIGHTNESS_LEDC_CH
        int "Backlight LEDC channel"
        default 1
        range 0 7

    menu "SPIFFS"
        config BSP_SPIFFS_MOUNT_POINT
            string "Mount point"
            default "/spiffs"

        config BSP_SPIFFS_PARTITION_LABEL
            string "Partition label"
            default "storage"

        config BSP_SPIFFS_MAX_FILES
            int "Max open files"
            default 5
    endmenu

    menu "RGB LED strip"
        comment "Data pin is GPIO61, shared with BOOT."

        config BSP_LED_STRIP_COUNT
            int "Number of LEDs"
            default 12
            range 1 256
    endmenu

    menu "USB"
        comment "ESP32-S31 USB OTG is USB 2.0 High Speed on the internal UTMI PHY."
        comment "D+ and D- are the dedicated USB_DP and USB_DM pads, not GPIO numbers."

        config BSP_USB_MSC
            bool "USB mass-storage (U-disk) driver"
            default n
            help
                Expose a FAT partition as a USB 2.0 disk through TinyUSB.
                The example partition label must match BSP_USB_MSC_PARTITION_LABEL.

        config BSP_USB_MSC_PARTITION_LABEL
            string "FAT partition label exposed as the USB disk"
            depends on BSP_USB_MSC
            default "udisk"
    endmenu

endmenu
```

## touch/esp_lcd_touch_chsc6540/dist/esp_lcd_touch_chsc6540_1.0.0/Kconfig
```kconfig
menu "ESP LCD TOUCH - CHSC6540"

    config ESP_LCD_TOUCH_CHSC6540_DISABLE_READ_ID
        bool "Disable reading chip ID during init"
        default n
        help
            Some CHSC6540 modules may fail I2C ID read before the first touch event.
            Enable this option to skip reading register 0xA7 during initialization.

endmenu
```
